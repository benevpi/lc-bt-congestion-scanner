## firmware/boards/seeed/xiao_nrf54l15_sense/Kconfig.xiao_nrf54l15_sense
```kconfig
# Copyright (c) 2025 Seeed Technology Co., Ltd.
# SPDX-License-Identifier: Apache-2.0
config BOARD_XIAO_NRF54L15_SENSE
	select SOC_NRF54L15_CPUAPP if BOARD_XIAO_NRF54L15_SENSE_NRF54L15_CPUAPP
	select SOC_NRF54L15_CPUFLPR if \
		BOARD_XIAO_NRF54L15_SENSE_NRF54L15_CPUFLPR || \
		BOARD_XIAO_NRF54L15_SENSE_NRF54L15_CPUFLPR_XIP
```

## firmware/boards/seeed/xiao_nrf54l15_sense/board.yml
```yaml
board:
  name: xiao_nrf54l15_sense
  full_name: XIAO nRF54L15 Sense
  vendor: seeed
  socs:
  - name: nrf54l15
```
